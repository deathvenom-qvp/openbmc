## meta-asrock/epyccd8t2/conf/layer.conf
```bitbake
# We have a conf and classes directory, add to BBPATH
BBPATH .= ":${LAYERDIR}"

# We have recipes-* directories, add to BBFILES
BBFILES += "${LAYERDIR}/recipes-*/*/*.bb \
            ${LAYERDIR}/recipes-*/*/*.bbappend"

BBFILE_COLLECTIONS += "epyccd8t2-layer"
BBFILE_PATTERN_epyccd8t2-layer = "^${LAYERDIR}/"
LAYERSERIES_COMPAT_epyccd8t2-layer = "scarthgap styhead"
```
